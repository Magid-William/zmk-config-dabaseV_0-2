## boards/shields/dabase_v2/Kconfig.defconfig
```kconfig
# Copyright (c) 2020 The ZMK Contributors
# SPDX-License-Identifier: MIT

if SHIELD_DABASE_V2_RIGHT

config ZMK_SPLIT_ROLE_CENTRAL
	default y

endif

if SHIELD_DABASE_V2_LEFT || SHIELD_DABASE_V2_RIGHT

config ZMK_SPLIT
	default y

config I2C
	default y
      
config ZMK_POINTING
	default y

endif
```

## boards/shields/dabase_v2/Kconfig.shield
```kconfig
# Copyright (c) 2020 The ZMK Contributors
# SPDX-License-Identifier: MIT

config SHIELD_DABASE_V2_LEFT
	def_bool $(shields_list_contains,dabase_v2_left)

config SHIELD_DABASE_V2_RIGHT
	def_bool $(shields_list_contains,dabase_v2_right)
```

## drivers/input/Kconfig
```kconfig
config INPUT_TPS43
    bool "Azoteq TPS43 I2C Touchpad Input Device"
    default y
    depends on I2C
    depends on INPUT
    help
      Enable driver for Azoteq touchpad input device over I2C interface.
      Supports multitouch gestures, scrolling, clicks and power management.

if INPUT_TPS43

config INPUT_TPS43_INIT_PRIORITY
    int "Init priority"
    default 90
    help
      Device driver initialization priority.

config INPUT_TPS43_POLL_INTERVAL_MS
    int "Polling interval while touched, when no rdy-gpios is wired (ms)"
    range 1 1000
    default 15
    help
      dabase_v2 patch: the PCB does not route the trackpad RDY line, so the
      driver cannot be interrupt driven. When the devicetree node has no
      rdy-gpios, the driver reads the report window on a timer instead.
      This is the period used while a finger is on the pad.

config INPUT_TPS43_POLL_IDLE_INTERVAL_MS
    int "Polling interval while untouched, when no rdy-gpios is wired (ms)"
    range 1 2000
    default 20
    help
      dabase_v2 patch: slower poll period used while no finger is detected,
      to keep the I2C bus (and the MCU) quiet when the pad is not in use.

config INPUT_TPS43_REPORT_TOUCH
    bool "Report BTN_TOUCH on finger contact"
    default n
    help
      Report INPUT_BTN_TOUCH when a finger touches the pad. ZMK's input
      listener turns that into a held left mouse button, which makes every
      touch a drag/selection. Off by default; the pad's tap and
      press-and-hold gestures still click and drag.

config INPUT_TPS43_SCROLL_BOTH_AXES
    bool "Report both scroll axes per report window"
    default y
    help
      dabase_v2 patch: the upstream scroll path keeps only the dominant axis
      of each report window, so diagonal two-finger swipes are flattened onto
      one axis. With this enabled both the horizontal and vertical wheel are
      reported from the same window and diagonal scrolling works.

config INPUT_TPS43_LAYER_KEEPALIVE_MS
    int "Keep the temp layer alive while a finger is on the pad (ms, 0 = off)"
    range 0 1000
    default 100
    help
      dabase_v2: with the pad's gestures disabled, mouse buttons come from a
      ZMK temp layer that is only re-armed by pad events. Emitting a benign
      zero REL_MISC event this often while a finger is in contact keeps the
      layer active during a still touch (and for the temp layer's own
      timeout after the finger lifts). 0 disables the keep-alive.

config INPUT_TPS43_JITTER_GATE_COUNTS
    int "Ignore pad coordinate noise below this many counts (0 = off)"
    range 0 20
    default 2
    depends on INPUT_TPS43
    help
      dabase_v2: with a finger resting on the pad, the IQS5xx still reports
      +-1-2 counts of coordinate noise per report window. The sensitivity
      remainder turns that into a visible 1-2 px wobble. The gate holds
      deltas back per axis until they reach this many counts, so oscillation
      cancels itself out while deliberate slow movement still passes (at most
      one report later). 0 disables the gate and restores the raw path.

config INPUT_TPS43_JITTER_MIN_RUN
    int "Movement reports a run must have before it is emitted (0/1 = no run gate)"
    range 0 10
    default 2
    depends on INPUT_TPS43
    help
      dabase_v2: a finger resting on the pad produces isolated single-report
      blips of +-1 count, and on the layer-6 scroll path each one becomes a
      full wheel tick. Requiring this many movement reports in a row (a zero
      report ends the run) drops the isolated blips. Measured on a resting
      finger: 82 emitted reports per 8 s with only the count gate, 11 with a
      run of 2. Continuous slow movement still produces runs, because the pad
      accumulates its delta since the previous read.

config INPUT_TPS43_POWER_POLICY
    bool "Cut the pad's power rail while the keyboard is idle"
    default n
    depends on INPUT_TPS43
    help
      dabase_v2: drive the pad's VCC rail (nice_nano EXT_VCC, P0.13) from
      ZMK's activity state. The rail is cut when the keyboard goes idle and
      restored on the next activity or when USB appears; the pad is
      reconfigured over I2C after every restore because the IQS5xx loses its
      registers on power loss. Nothing wakes the pad itself: the next key
      press does.

config INPUT_TPS43_RAW_DIAG
    bool "Log the raw report window (bring-up)"
    default n
    help
      dabase_v2 bring-up aid: prints the raw gesture/status/finger/relative
      window read from the pad, when it changes and every 2 s.

config INPUT_TPS43_TRACKPOINT
    bool "Trackpoint-style velocity from the touch landing point"
    default n
    help
      dabase_v2 experiment: read the pad's absolute coordinates and turn the
      offset from the landing point into a continuous cursor velocity. Inside
      the deadzone the pointer does not move. The pad's raw relative deltas are
      not reported while this is on. Toggle at runtime with
      `tps43_tp mode off` (the feature also pulls in live shell tuning).

config INPUT_TPS43_TRACKPOINT_LAYER
    int "Trackpoint velocity mode layer (-1 = all layers)"
    range -1 31
    default 6
    help
      dabase_v2: use the absolute-position velocity path only while this
      keymap layer is active. -1 keeps the old behaviour of using it on every
      layer. The default 6 is the scroll layer (hold J), so the normal layers
      keep the ordinary relative trackpad pointer.

config INPUT_TPS43_TRACKPOINT_DEADZONE_RADIUS_COUNTS
    int "Trackpoint deadzone radius (pad counts)"
    range 0 1000
    default 38
    help
      Radius around the landing point where no motion is emitted. 38 counts
      is about 0.75 mm on the TPS43 (1.5 mm diameter) at 51.2 counts/mm.

config INPUT_TPS43_TRACKPOINT_RADIUS_COUNTS
    int "Trackpoint full-speed radius (pad counts)"
    range 1 4096
    default 512
    help
      Offset from the landing point where the speed curve reaches its
      maximum. 512 counts is about 10 mm on the TPS43.

config INPUT_TPS43_TRACKPOINT_MAX_SPEED
    int "Trackpoint maximum cursor speed (px/s)"
    range 50 5000
    default 1000
    help
      Cursor speed at the full-speed radius.

config INPUT_TPS43_TRACKPOINT_EXPONENT_X100
    int "Trackpoint speed curve exponent (x100)"
    range 50 500
    default 200
    help
      speed = max_speed * normalized_offset^(exponent/100). 100 is linear,
      200 is quadratic, 300 is cubic.

config INPUT_TPS43_TRACKPOINT_COUNTS_PER_MM
    int "Trackpoint pad scale (counts per mm)"
    range 1 500
    default 51
    help
      Used by the live shell to convert mm to counts and back. The TPS43
      reports 2048 x 1792 counts over roughly 40 x 35 mm, i.e. 51.2 counts/mm.

endif # INPUT_TPS43
```

## dts/bindings/dabase,tps43-rail.yaml
```yaml
description: |
  Power rail control for the Azoteq TPS43 touchpad (dabase_v2).

  The pad is powered from the nice!nano EXT_VCC rail, which the firmware
  gates on ZMK's activity state. On restore the pad reboots and must be
  reconfigured over I2C, so boot-mute-ms is the delay between switching the
  rail on and re-running the driver's init sequence.

compatible: "dabase,tps43-rail"

properties:
  gpios:
    type: phandle-array
    required: true
    description: Rail enable pin (active high drives the pad's VCC).

  boot-mute-ms:
    type: int
    default: 800
    description: Delay after switching the rail on before reconfiguring the pad.
```
