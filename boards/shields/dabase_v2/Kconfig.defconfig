## boards/shields/dabase_v2/Kconfig.defconfig
```kconfig
# Copyright (c) 2020 The ZMK Contributors
# SPDX-License-Identifier: MIT

if SHIELD_DABASE_V2_DONGLE

config ZMK_KEYBOARD_NAME
	default "Dabase_v2 tmls"
	
config ZMK_SPLIT_ROLE_CENTRAL
	default y

endif

if SHIELD_DABASE_V2_RIGHT

config ZMK_SPLIT_ROLE_CENTRAL
	default y

endif

if SHIELD_DABASE_V2_LEFT || SHIELD_DABASE_V2_RIGHT || SHIELD_DABASE_V2_DONGLE 

config ZMK_SPLIT
	default y

config I2C
	default y
      
config ZMK_POINTING
	default y

endif
```
